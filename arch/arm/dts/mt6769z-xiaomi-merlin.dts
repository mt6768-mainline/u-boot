/*
 * Device tree for Xiaomi Redmi Note 9
 * codename: merlin
 */

/dts-v1/;
/* It's actually MT6769Z (Helio G85) but doesn't differ a lot */
#include "mt6768.dtsi"

/ {
  model = "Xiaomi Redmi Note 9";
  compatible = "xiaomi,merlin", "mediatek,mt6769z";
  chassis-type = "handset";
  
  /* Use framebuffer set up by previous LK bootloader */
  framebuffer0: framebuffer@7d9b0000 {
    compatible = "simple-framebuffer";
    /* mblock-13-framebuffer */
    reg = <0 0x7d9b0000 0 0x2250000>;
    format = "a8r8g8b8";
    width = <1080>;
    height = <2340>;
    stride = <((1080 + 8) * 4)>;
    status = "okay";
  };
};

&uart0 {
  status = "okay";
};