## configs/merlin_defconfig
```kconfig
CONFIG_ARM=y
CONFIG_SYS_BOARD="mt6768"
CONFIG_POSITION_INDEPENDENT=y
CONFIG_GICV3_SUPPORT_GIC600=y
CONFIG_ARCH_MEDIATEK=y
CONFIG_TEXT_BASE=0x40080000
CONFIG_ENV_SOURCE_FILE="merlin"
CONFIG_NR_DRAM_BANKS=2
CONFIG_ENV_SIZE=0x4000
CONFIG_ENV_OFFSET=0
CONFIG_DM_GPIO=y
CONFIG_DEFAULT_DEVICE_TREE="mt6768-xiaomi-merlin-nt36672a-ktd3137"
CONFIG_DM_RESET=y
CONFIG_SYS_LOAD_ADDR=0x48000000
CONFIG_DEBUG_UART_BASE=0x11002000
CONFIG_DEBUG_UART_CLOCK=26000000
CONFIG_DEBUG_UART=y
CONFIG_OPTIMIZE_INLINING=y
CONFIG_SYS_BOOT_GET_CMDLINE=y
CONFIG_SYS_BOOT_GET_KBD=y
# CONFIG_EFI_LOADER is not set
CONFIG_ANDROID_BOOT_IMAGE_IGNORE_BLOB_ADDR=y
CONFIG_TIMESTAMP=y
CONFIG_BUTTON_CMD=y
CONFIG_FIT=y
CONFIG_FIT_VERBOSE=y
CONFIG_FIT_BEST_MATCH=y
CONFIG_BOOTSTD_FULL=y
CONFIG_BOOTMETH_ANDROID=y
# CONFIG_LEGACY_IMAGE_FORMAT is not set
CONFIG_BOOTDELAY=0
# CONFIG_USE_BOOTCOMMAND is not set
CONFIG_SAVE_PREV_BL_INITRAMFS_START_ADDR=y
CONFIG_LOGLEVEL=6
# CONFIG_SYS_DEVICE_NULLDEV is not set
CONFIG_LOG=y
CONFIG_LOGF_FILE=y
CONFIG_LOGF_LINE=y
CONFIG_LOGF_FUNC=y
CONFIG_LOG_ERROR_RETURN=y
CONFIG_STACKPROTECTOR=y
# CONFIG_CMD_BOOTDEV is not set
# CONFIG_CMD_BOOTMETH is not set
# CONFIG_CMD_BOOTSTD is not set
# CONFIG_CMD_VBE is not set
CONFIG_CMD_BOOTMENU=y
# CONFIG_CMD_BIND is not set
CONFIG_CMD_CLK=y
CONFIG_CMD_DM=y
CONFIG_CMD_FASTBOOT_ABORT_KEYED=y
CONFIG_CMD_GPIO=y
CONFIG_CMD_GPIO_READ=y
CONFIG_CMD_GPT=y
CONFIG_CMD_I2C=y
CONFIG_CMD_LOADM=y
CONFIG_CMD_LSBLK=y
CONFIG_CMD_MMC=y
CONFIG_CMD_BKOPS_ENABLE=y
CONFIG_CMD_MMC_REG=y
CONFIG_MMC_SPEED_MODE_SET=y
CONFIG_CMD_PART_DUPCHECK=y
CONFIG_CMD_POWEROFF=y
CONFIG_CMD_READ=y
CONFIG_CMD_SDRAM=y
CONFIG_CMD_USB_MASS_STORAGE=y
CONFIG_CMD_UMS_ABORT_KEYED=y
CONFIG_CMD_SYSBOOT=y
# CONFIG_ISO_PARTITION is not set
CONFIG_ENV_IS_IN_MMC=y
CONFIG_ENV_MMC_USE_SW_PARTITION=y
CONFIG_ENV_MMC_SW_PARTITION="dtbo"
CONFIG_NO_NET=y
CONFIG_BUTTON_REMAP_PHONE_KEYS=y
CONFIG_BUTTON_MTK_PMIC=y
CONFIG_CLK=y
CONFIG_CLK_AUTO_ID=y
CONFIG_CLK_STUB=y
CONFIG_USB_FUNCTION_FASTBOOT=y
CONFIG_FASTBOOT_BUF_ADDR=0x48000000
CONFIG_FASTBOOT_BUF_SIZE=0x20000000
CONFIG_FASTBOOT_FLASH=y
CONFIG_FASTBOOT_FLASH_MMC_DEV=0
CONFIG_FASTBOOT_MMC_BOOT_SUPPORT=y
CONFIG_FASTBOOT_CMD_OEM_FORMAT=y
CONFIG_FASTBOOT_OEM_RUN=y
CONFIG_FASTBOOT_OEM_BOARD=y
CONFIG_SYS_I2C_MTK=y
CONFIG_DM_KEYBOARD=y
CONFIG_BUTTON_KEYBOARD=y
CONFIG_MEDIATEK_KEYBOARD=y
CONFIG_MTK_SMI=y
CONFIG_SUPPORT_EMMC_RPMB=y
CONFIG_SUPPORT_EMMC_BOOT=y
CONFIG_MMC_IO_VOLTAGE=y
CONFIG_MMC_UHS_SUPPORT=y
CONFIG_MMC_HS400_ES_SUPPORT=y
CONFIG_MMC_HS400_SUPPORT=y
CONFIG_MMC_MTK=y
CONFIG_PHY=y
CONFIG_PHY_MTK_MIPI_DSI=y
CONFIG_PHY_MTK_TPHY=y
CONFIG_PHY_COMMON_PROPS=y
CONFIG_PINCTRL=y
CONFIG_POWER_DOMAIN=y
CONFIG_DM_PMIC=y
CONFIG_DM_PMIC_MTK_PWRAP=y
CONFIG_DM_REGULATOR=y
CONFIG_DM_REGULATOR_FIXED=y
CONFIG_DM_REGULATOR_GPIO=y
CONFIG_DM_REGULATOR_MT6358=y
CONFIG_RESET_SYSCON=y
CONFIG_BAUDRATE=921600
CONFIG_DM_SERIAL=y
CONFIG_DEBUG_UART_SHIFT=2
CONFIG_DEBUG_UART_ANNOUNCE=y
CONFIG_MTK_SERIAL=y
CONFIG_SOC_MTK=y
CONFIG_MTK_MMSYS=y
CONFIG_MTK_MUTEX=y
CONFIG_TIMER=y
CONFIG_MTK_TIMER=y
CONFIG_USB=y
CONFIG_USB_MUSB_GADGET=y
CONFIG_USB_MUSB_MEDIATEK=y
CONFIG_USB_GADGET=y
CONFIG_USB_FUNCTION_ACM=y
CONFIG_VIDEO=y
# CONFIG_VIDEO_FONT_8X16 is not set
CONFIG_VIDEO_FONT_SUN12X22=y
CONFIG_VIDEO_ANSI=y
CONFIG_SYS_WHITE_ON_BLACK=y
CONFIG_VIDEO_LCD_NOVATEK_NT36672A=y
CONFIG_VIDEO_MTK=y
CONFIG_BACKLIGHT_KTD3137=y
CONFIG_WDT=y
CONFIG_WDT_MTK=y
CONFIG_FAT_WRITE=y
# CONFIG_RANDOM_UUID is not set
```

## drivers/soc/mediatek/Kconfig
```kconfig
# SPDX-License-Identifier: GPL-2.0+
menuconfig SOC_MTK
	bool "MediaTek SoC drivers support"
	depends on ARCH_MEDIATEK
	help
	  Say Y here if you want to enable MediaTek SoC driver support.

if SOC_MTK

config MTK_MMSYS
	bool "MediaTek MMSYS"
	select MEMORY
	help
	  Say Y here if you want to enable MediaTek MultiMedia subSYStem
	  support.

config MTK_MUTEX
	bool "MediaTek MUTE-X"
	select MISC
	help
	  Say Y here if you want to enable MediaTek MUTE-X support.

endif
```
